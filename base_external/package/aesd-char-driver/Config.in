## base_external/package/aesd-char-driver/Config.in
```kconfig
config BR2_PACKAGE_AESD_CHAR_DRIVER
    tristate "aesd-char-driver"
    depends on BR2_LINUX_KERNEL
    help
      Includes the aesdchar driver and loading scripts.
```
